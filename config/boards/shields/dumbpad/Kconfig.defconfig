## config/boards/shields/dumbpad/Kconfig.defconfig
```kconfig
# Copyright (c) 2021 The ZMK Contributors
# SPDX-License-Identifier: MIT

if SHIELD_DUMBPAD

config ZMK_KEYBOARD_NAME
	default "DumbPad"

if ZMK_DISPLAY

config I2C
	default y

config SSD1306
	default y

config SSD1306_REVERSE_MODE
	default y

endif # ZMK_DISPLAY

endif
```

## config/boards/shields/dumbpad/Kconfig.shield
```kconfig
# Copyright (c) 2021 The ZMK Contributors
# SPDX-License-Identifier: MIT

config SHIELD_DUMBPAD
	def_bool $(shields_list_contains,dumbpad)
```

## config/boards/shields/eternal_keypad/Kconfig.defconfig
```kconfig
if SHIELD_ETERNAL_KEYPAD

config ZMK_KEYBOARD_NAME
	default "Eternal Keypad"

endif
```

## config/boards/shields/eternal_keypad/Kconfig.shield
```kconfig
# Copyright (c) 2020 Pete Johanson
# SPDX-License-Identifier: MIT

config SHIELD_ETERNAL_KEYPAD
	def_bool $(shields_list_contains,eternal_keypad)
```
